bool Flag = false;
int incomingByte = 0;
#include <Wire.h>
#include "Adafruit_DRV2605.h"

Adafruit_DRV2605 drv;

void setup() {
  Flag = false;
  Serial.begin(9600);
  Serial.println("DRV test");
  drv.begin();
    
  // Set Real-Time Playback mode
  drv.setMode(DRV2605_MODE_REALTIME);
}

uint8_t rtp_index = 0;
uint8_t rtp[] = {100,100,100,100,100,100,100,100,100,200,100,100,100,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100
}; 
// standard = 100ms  deviant = 200ms 
// Change to random sequence for each participant

void loop() {
  if (Serial.available() > 0) {
    // read the incoming byte:
    incomingByte = Serial.read();
  }
  if (incomingByte == 100) {
    Flag = true; 
    if (Flag == true && rtp_index < sizeof(rtp)/sizeof(rtp[0])) {
       if (rtp[rtp_index] == 200) {
         Serial.write(4); //deviant stimulus onset
         drv.setRealtimeValue(0x7F);
         delay(rtp[rtp_index]);
         Serial.write(88); //stimulus ends
        }
        else if (rtp[rtp_index] == 100) {
          Serial.write(2); //standard stimulus onset
         drv.setRealtimeValue(0X7F);
         delay(rtp[rtp_index]);
         Serial.write(88); //stimulus ends         
        }
      drv.setRealtimeValue(0x00);
      delay(1000);
      rtp_index++;
   } else {
      drv.setRealtimeValue(0x00);
      delay(1000000);
   }
} else {
  Flag = false;
}
}
